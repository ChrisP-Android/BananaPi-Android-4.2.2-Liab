## lichee/linux-3.4/drivers/char/sun7i_g2d/Kconfig
```kconfig
config SUN7I_G2D
	depends on ARCH_SUN7I
	tristate "SUN7I G2D"
	default y
#	depends on HAS_IOMEM
	help
```

## lichee/linux-3.4/drivers/gsensor/Kconfig
```kconfig
#
# I2C gsensor chip drivers configuration
#

menuconfig GSENSOR 
	bool "Gsensor support"

if GSENSOR

config SENSORS_MXC622X
	tristate "MEMSIC Accelerometer Sensor MXC622X Driver Support"
	depends on I2C 
	default m
	help
	  If you say yes here you get support for the MEMSIC accelerometer sensor

config SENSORS_BMA250
	tristate "BMA250 acceleration sensor support"
	depends on I2C
	help
	  If you say yes here you get support for Bosch Sensortec's 
	  acceleration sensors BMA250.
	  
config SENSORS_LIS3DH_ACC
	tristate "LIS3DH acceleration sensor support"
	depends on I2C
	default m
	help
	  If you say yes here you get support for acceleration sensors LIS3DH.

config SENSORS_LIS3DE_ACC
	tristate "LIS3DE acceleration sensor support"
	depends on I2C
	default m
	help
	  If you say yes here you get support for acceleration sensors LIS3DE.
	  
config SENSORS_DMARD10
	tristate "dmard10 acceleration sensor support"
	depends on I2C
	help
	  If you say yes here you get support for  acceleration sensors DMARD10.
	  
config SENSORS_STK831X
	tristate "Accelerometer Sensor STK8312&STK8313 Driver Support"
	depends on I2C 
	default m
	help
	  If you say yes here you get support for the STK8312&STK8313 accelerometer sensor

###### not supported yet ######
if 0  
config MEMSIC_ECOMPASS
	tristate "MEMSIC eCompass Driver Support"
	depends on I2C
	help
	  If you say yes here you get support for the MEMSIC eCompass

config SENSORS_MXC622X
	tristate "MEMSIC Accelerometer Sensor MXC622X Driver Support"
	depends on I2C && MEMSIC_ECOMPASS
	help
	  If you say yes here you get support for the MEMSIC accelerometer sensor

config SENSORS_MXC6202X
	tristate "MEMSIC Accelerometer Sensor MXC6202X Driver Support"
	depends on I2C
	help
	  If you say yes here you get support for the MEMSIC accelerometer sensor

config SENSORS_MMC31XX
	tristate "MEMSIC Magnetic Sensor MMC31XX Driver Support"
	depends on I2C
	help
	  If you say yes here you get support for the MEMSIC magnateic sensor
endif
###### not supported yet ########


endif
```

## lichee/linux-3.4/drivers/input/e_compass/Kconfig
```kconfig
#
# Input core configuration
#
menuconfig INPUT_E_COMPASS
	bool "e_compass"
	default y
	help
	  Say Y here, and a list of supported e_compass will be displayed.
	  This option doesn't affect the kernel.

	  If unsure, say Y.

if INPUT_E_COMPASS

config E_COMPASS_L3M303D
        tristate "E_COMPASS_L3M303D support"
        depends on I2C
        help
          Say Y here to enable the E_COMPASS_L3M303D.

config E_COMPASS_FXOS8700
        tristate "E_COMPASS_FXOS8700 support"
        depends on I2C
        help
          Say Y here to enable the E_COMPASS_FXOS8700.
       
endif
```

## lichee/linux-3.4/drivers/input/gyr/Kconfig
```kconfig
#
# Input core configuration
#
menuconfig INPUT_GYR
	bool "gyroscope"
	default y
	help
	  Say Y here, and a list of supported gyroscope will be displayed.
	  This option doesn't affect the kernel.

	  If unsure, say Y.

if INPUT_GYR

config GYR_L3GD20
        tristate "GYR_L3GD20_GYR support"
        depends on I2C
        help
          Say Y here to enable the gyroscope.
       
endif
```

## lichee/linux-3.4/drivers/input/lightsensor/Kconfig
```kconfig
#
# Input light_sensor drivers configuration
#
menuconfig INPUT_LIGHT_SENSOR
	bool "light_sensor"
	default y
	help
	  Say Y here, and a list of supported light_sensor will be displayed.
	  This option doesn't affect the kernel.

	  If unsure, say Y.

if INPUT_LIGHT_SENSOR
config INPUT_AL3010
	tristate "al3010 LIGHT SENSOR driver"
	depends on I2C && INPUT
	default m
	help
	  Say Y here if you want to useal3010
	  through I2C interface.

	  To compile this driver as a module, choose M here: the
	  module will be called al3010.
	  
endif
```

## lichee/linux-3.4/drivers/input/sw_touchscreen/Kconfig
```kconfig
#
# SW Touchscreen driver configuration
#
menuconfig INPUT_SW_TOUCHSCREEN
	bool "sw Touchscreens"
	help
	  Say Y here, and a list of supported touchscreens will be displayed.
	  This option doesn't affect the kernel.

	  If unsure, say Y.

if INPUT_SW_TOUCHSCREEN         
         
config SW_TOUCHSCREEN_ZET622X
       tristate  "zet622x touchscreen driver"
       default m
       depends on INPUT && I2C
       help
         zet622x touchscreen driver

config  SW_TOUCHSCREEN_GSLX680
       tristate  "gslX680 touchscreen driver"
       default m
       depends on INPUT && I2C
       help
         gslX3680,gslX2680,gsl1680 touchscreen driver ,     
         
config  SW_TOUCHSCREEN_GT82X
       tristate  "gt82x touchscreen driver"
       default m
       depends on INPUT && I2C
       help
         gt813,gt827,gt828 touchscreen driver
         
config  SW_TOUCHSCREEN_SUNXI_TS
       tristate  "sunxi-ts touchscreen driver"
       help
           sunxi-ts touchscreen driver of resistance          
         
config  SW_TOUCHSCREEN_GT811
       tristate  "gt811 touchscreen driver"
       default m
       depends on INPUT && I2C
       help
         gt811 touchscreen driver   

config TOUCHSCREEN_AW5306
       tristate  "aw5306 touchscreen driver"
       default m
       depends on INPUT && I2C
       help
         aw5306 touchscreen driver 

config TOUCHSCREEN_ILITEK
       tristate  "ilitek touchscreen driver"
       default m
       depends on INPUT && I2C
       help
         ilitek touchscreen driver
                  
         
source "drivers/input/sw_touchscreen/ft5x/Kconfig"

source "drivers/input/sw_touchscreen/gt9xx/Kconfig"

endif
```

## lichee/linux-3.4/drivers/input/sw_touchscreen/ft5x/Kconfig
```kconfig
#
# SW Touchscreen ft5x driver configuration
#
menuconfig SW_TOUCHSCREEN_FT5X
	bool "ft5x Touchscreens driver "
	help
	  Say Y here, and a list of supported touchscreens will be displayed.
	  This option doesn't affect the kernel.

	  If unsure, say Y.

if SW_TOUCHSCREEN_FT5X   
      
config SW_TOUCHSCREEN_FT5X_TS
       tristate  "ft5x touchscreen driver"
       default m
       depends on INPUT && I2C
       help
         ft5x touchscreen driver    
endif
```

## lichee/linux-3.4/drivers/input/sw_touchscreen/gt9xx/Kconfig
```kconfig
#
# SW Touchscreen driver configuration
#
menuconfig SW_TOUCHSCREEN_GT9XX
	bool "gt9xx Touchscreens driver"
	help
	  Say Y here, and a list of supported touchscreens will be displayed.
	  This option doesn't affect the kernel.

	  If unsure, say Y.

if SW_TOUCHSCREEN_GT9XX         

config  SW_TOUCHSCREEN_GT9XX_TS
       tristate  "gt9xxtouchscreen driver"      
       depends on INPUT && I2C
       default m
       help
         gt9xx touchscreen driver    
         
endif
```

## lichee/linux-3.4/drivers/media/video/sun7i/Kconfig
```kconfig
config VIDEO_DECODER_SUN7I
	tristate "sun7i video decoder support"
	depends on VIDEO_SUN7I_CEDAR
	default y
	---help---
	  This is the driver for sun7i video decoder, including h264/
	  mpeg4/mpeg2/vc1/rmvb. 
	  To compile this driver as a module, choose M here: the
	  module will be called cedar_dev.
```

## lichee/linux-3.4/drivers/media/video/sun7i_tvd/Kconfig
```kconfig
config SUN7I_TVD
	tristate "TV Decoder"
	default m
	depends on VIDEO_DEV && VIDEO_V4L2
	select VIDEOBUF_DMA_CONTIG
	help
	  This is the driver of TV decoder.
```

## lichee/linux-3.4/drivers/net/wireless/rtl8723au/Kconfig
```kconfig
config RTL8723AU
	tristate "Realtek 8723A USB WiFi"
	depends on USB
	select WIRELESS_EXT
	select WEXT_PRIV	
	---help---
	  Help message of RTL8723AU
```

## lichee/linux-3.4/sound/soc/sun7i/hdcp/Kconfig
```kconfig
config SND_SUN7I_SOC_HDCP_INTERFACE
	tristate "SoC hdcp interface for the ReuuiMlla SUN7I chips"
	default n
	help
	  Say Y or M if you want to add support for codecs attached to
	  the SUN7I AC97, I2S or PCM interface. You will also need
	  to select the audio interfaces to support below.
```

## lichee/linux-3.4/sound/soc/sun7i/hdmiaudio/Kconfig
```kconfig
config SND_SUN7I_SOC_HDMIAUDIO
	tristate "HDMI Audio for the ReuuiMlla SUN7I chips"
	default n
	help
	  Say Y or M if you want to add support for hdmi audio
```

## lichee/linux-3.4/sound/soc/sun7i/i2s/Kconfig
```kconfig
config SND_SUN7I_SOC_I2S_INTERFACE
	tristate "SoC i2s interface for the ReuuiMlla SUN7I chips"
	default n
	help
	  Say Y or M if you want to add support for codecs attached to
	  the SUN7I AC97, I2S or PCM interface. You will also need
	  to select the audio interfaces to support below.
```

## lichee/linux-3.4/sound/soc/sun7i/pcm/Kconfig
```kconfig
config SND_SUN7I_SOC_PCM_INTERFACE
	tristate "SoC pcm interface for the ReuuiMlla SUN7I chips"
	default n
	help
	  Say Y or M if you want to add support for codecs attached to
	  the SUN7I AC97, I2S or PCM interface. You will also need
	  to select the audio interfaces to support below.
```
